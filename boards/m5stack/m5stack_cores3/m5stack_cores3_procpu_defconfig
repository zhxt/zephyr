## boards/m5stack/m5stack_cores3/m5stack_cores3_procpu_defconfig
```kconfig
# SPDX-License-Identifier: Apache-2.0


CONFIG_MAIN_STACK_SIZE=2048
CONFIG_CONSOLE=y
CONFIG_SERIAL=y
CONFIG_UART_CONSOLE=y
CONFIG_I2C=y
CONFIG_SPI=y
CONFIG_GPIO=y
CONFIG_GPIO_AW9523B=y
CONFIG_REGULATOR=y
CONFIG_REGULATOR_AXP2101=y

CONFIG_SHELL=y
CONFIG_I2C_SHELL=y
CONFIG_SPI_SHELL=y
CONFIG_GPIO_SHELL=y
CONFIG_REGULATOR_SHELL=y

CONFIG_LOG=y
CONFIG_LOG_CMDS=y
CONFIG_LOG_BACKEND_UART=y
CONFIG_GPIO_LOG_LEVEL_DBG=y

CONFIG_MIPI_DBI=y

CONFIG_LV_Z_MEM_POOL_SIZE=16384
CONFIG_LV_Z_SHELL=y

CONFIG_DISPLAY=y
CONFIG_ILI9342C=y
CONFIG_DISPLAY_LOG_LEVEL_ERR=y

CONFIG_LVGL=y

CONFIG_LV_MEM_CUSTOM=y
CONFIG_LV_USE_LOG=y
CONFIG_LV_USE_LABEL=y
CONFIG_LV_USE_BTN=y
CONFIG_LV_USE_ARC=y
CONFIG_LV_USE_IMG=y
CONFIG_LV_USE_MONKEY=y
CONFIG_LV_FONT_MONTSERRAT_14=y
```

## dts/bindings/gpio/awinic,aw9523b-gpio.yaml
```yaml
# Copyright (c) 2024 Zhang Xingtao
# SPDX-License-Identifier: Apache-2.0

description: AW9523B GPIO Controller

  AW9523B features 16 native GPIOs.

  Pin-info
  Drop out performance of P1_0~P1_3,P0_0~P0_1 has been enhanced, better choices for drive LCD backlight.

    1  P1_0
    2  P1_1
    3  P1_2
    4  P1_3
    5  P0_0
    6  P0_1
    7  P0_2
    8  P0_3
    9  GND
    10 P0_4
    11 P0_5
    12 P0_6
    13 P0_7
    14 P1_4
    15 P1_5
    16 P1_6
    17 P1_7
    18 AD0
    19 SCL
    20 SDA
    21 VCC
    22 INTN
    23 RSTN
    24 AD1
    25 GND


compatible: "awinic,aw9523b-gpio"

include: gpio-controller.yaml

properties:
  "#gpio-cells":
    const: 2

gpio-cells:
  - pin
  - flags
```

## dts/bindings/mfd/awinic,aw9523b.yaml
```yaml
# Copyright (c) 2024 Zhang Xingtao
# SPDX-License-Identifier: Apache-2.0

description: Awinic aw9523b

compatible: "awinic,aw9523b"

include: i2c-device.yaml

properties:
  reg:
    required: true
```
