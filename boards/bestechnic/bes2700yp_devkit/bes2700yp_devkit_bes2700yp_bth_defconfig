## boards/bestechnic/bes2700yp_devkit/bes2700yp_devkit_bes2700yp_bth_defconfig
```kconfig
# SPDX-FileCopyrightText: Copyright The Zephyr Project Contributors
# SPDX-License-Identifier: Apache-2.0

CONFIG_ARM_MPU=n
CONFIG_FPU=n
CONFIG_XIP=y
CONFIG_INIT_ARCH_HW_AT_BOOT=y
CONFIG_SERIAL=y
CONFIG_CONSOLE=y
CONFIG_UART_CONSOLE=y
CONFIG_MAIN_STACK_SIZE=2048
```

## boards/bestechnic/bes2700yp_devkit/board.yml
```yaml
# SPDX-FileCopyrightText: Copyright The Zephyr Project Contributors
# SPDX-License-Identifier: Apache-2.0

board:
  name: bes2700yp_devkit
  full_name: BES2700YP Development Kit
  vendor: bestechnic
  socs:
    - name: bes2700yp
```

## drivers/serial/Kconfig.bes2700
```kconfig
# SPDX-FileCopyrightText: Copyright The Zephyr Project Contributors
# SPDX-License-Identifier: Apache-2.0

config UART_BES2700
	bool "BES2700 BTH UART"
	default y
	depends on DT_HAS_BESTECHNIC_BES2700_BTH_UART_ENABLED
	select SERIAL_HAS_DRIVER
	help
	  Polling UART using the clock and pins prepared by the loader.
	  Supports fixed 8N1 without flow control.
```

## dts/bindings/arm/bestechnic,bes2700yp-devkit.yaml
```yaml
# SPDX-FileCopyrightText: Copyright The Zephyr Project Contributors
# SPDX-License-Identifier: Apache-2.0

description: BES2700YP Development Kit

compatible: "bestechnic,bes2700yp-devkit"

include: base.yaml

properties:
  model:
    type: string
    description: Board model
```

## dts/bindings/serial/bestechnic,bes2700-bth-uart.yaml
```yaml
# SPDX-FileCopyrightText: Copyright The Zephyr Project Contributors
# SPDX-License-Identifier: Apache-2.0

description: |
  BES2700 BTH UART with PL011-style registers and BES RXEXT/OVSAMP.
  The loader must enable the clock and configure the pins before init.
  Supports fixed 8N1 with no flow control.

compatible: "bestechnic,bes2700-bth-uart"

include: uart-controller.yaml

properties:
  reg:
    required: true
  clock-frequency:
    required: true
  current-speed:
    required: true
  parity:
    const: "none"
  stop-bits:
    const: "1"
  data-bits:
    const: 8
```

## soc/bestechnic/bes2700yp/Kconfig
```kconfig
# SPDX-FileCopyrightText: Copyright The Zephyr Project Contributors
# SPDX-License-Identifier: Apache-2.0

config SOC_BES2700YP_BTH
	select ARM
	select CPU_CORTEX_M33
	select CPU_HAS_ARM_MPU
	select CPU_HAS_FPU
	select ARMV8_M_DSP
	select CPU_CORTEX_M_HAS_VTOR
	select CPU_CORTEX_M_HAS_SYSTICK

config SOC_BES2700YP_BOOT_IMAGE
	bool "Build a BES2700YP ROM boot image"
	depends on SOC_BES2700YP_BTH
	help
	  Build a standalone loader and package the final application ELF into
	  zephyr.bes.bin. The loader uses a separately selected GNU Arm toolchain
	  and the checked boot recipe. No flashing or power control is performed.
```

## soc/bestechnic/bes2700yp/Kconfig.defconfig
```kconfig
# SPDX-FileCopyrightText: Copyright The Zephyr Project Contributors
# SPDX-License-Identifier: Apache-2.0

if SOC_BES2700YP_BTH

config NUM_IRQS
	default 64

config SYS_CLOCK_HW_CYCLES_PER_SEC
	default $(dt_node_int_prop_int,/cpus/cpu@0,clock-frequency) if CORTEX_M_SYSTICK

endif # SOC_BES2700YP_BTH
```
