## boards/bestechnic/bes2700imp_devkit/Kconfig
```kconfig
# SPDX-FileCopyrightText: Copyright The Zephyr Project Contributors
# SPDX-License-Identifier: Apache-2.0

config BES2700IMP_DEVKIT_BOOT_IMAGE
	bool "Build the BES2700iMP Development Kit ROM image"
	depends on !XIP
	help
	  Package the SRAM application and standalone loader as
	  zephyr.bes.bin for the board's 128 KiB ROM boot window.
```

## boards/bestechnic/bes2700imp_devkit/Kconfig.bes2700imp_devkit
```kconfig
# SPDX-FileCopyrightText: Copyright The Zephyr Project Contributors
# SPDX-License-Identifier: Apache-2.0

config BOARD_BES2700IMP_DEVKIT
	select SOC_BES2700IMP
```

## boards/bestechnic/bes2700imp_devkit/Kconfig.defconfig
```kconfig
# SPDX-FileCopyrightText: Copyright The Zephyr Project Contributors
# SPDX-License-Identifier: Apache-2.0

if BOARD_BES2700IMP_DEVKIT

configdefault I2C_DW_CLOCK_SPEED
	default 24

endif # BOARD_BES2700IMP_DEVKIT
```

## boards/bestechnic/bes2700imp_devkit/bes2700imp_devkit_defconfig
```kconfig
# SPDX-FileCopyrightText: Copyright The Zephyr Project Contributors
# SPDX-License-Identifier: Apache-2.0

CONFIG_INIT_ARCH_HW_AT_BOOT=y
CONFIG_SERIAL=y
CONFIG_CONSOLE=y
CONFIG_UART_CONSOLE=y
CONFIG_XIP=n
```

## boards/bestechnic/bes2700imp_devkit/board.yml
```yaml
# SPDX-FileCopyrightText: Copyright The Zephyr Project Contributors
# SPDX-License-Identifier: Apache-2.0

board:
  name: bes2700imp_devkit
  full_name: BES2700iMP Development Kit
  vendor: bestechnic
  socs:
    - name: bes2700imp
```

## drivers/display/Kconfig.bes2700imp_panel
```kconfig
# SPDX-FileCopyrightText: Copyright The Zephyr Project Contributors
# SPDX-License-Identifier: Apache-2.0

config BES2700IMP_PANEL
	bool "BES2700iMP Development Kit LCDC panel"
	default y
	depends on DT_HAS_BESTECHNIC_BES2700IMP_DEVKIT_PANEL_ENABLED
	depends on SOC_BES2700IMP
	depends on SYS_CLOCK_EXISTS
	help
	  Enable the board's 212 by 520 panel using LCDC RGB565 transfers.
	  The board's initialization profile is a local build input.
```

## drivers/gpio/Kconfig.bes2700imp
```kconfig
# SPDX-FileCopyrightText: Copyright The Zephyr Project Contributors
# SPDX-License-Identifier: Apache-2.0

config GPIO_BES2700IMP
	bool "BES2700iMP GPIO"
	default y
	depends on DT_HAS_BESTECHNIC_BES2700IMP_GPIO_ENABLED
	help
	  Enable GPIO input, push-pull output, and falling-edge interrupts on
	  boards with the GPIO pads configured by platform initialization.
```

## drivers/input/Kconfig.ztw623
```kconfig
# SPDX-FileCopyrightText: Copyright The Zephyr Project Contributors
# SPDX-License-Identifier: Apache-2.0

config INPUT_ZTW623
	bool "Zinitix ZTW623 touchscreen controller"
	default y
	depends on DT_HAS_ZINITIX_ZTW623_ENABLED
	depends on I2C && GPIO
	select INPUT_TOUCH
	help
	  Enable single-contact touch reporting over I2C using an active-low
	  GPIO interrupt.

config INPUT_ZTW623_THREAD_STACK_SIZE
	int "ZTW623 worker stack size"
	default 1024
	depends on INPUT_ZTW623
```

## dts/bindings/display/bestechnic,bes2700imp-devkit-panel.yaml
```yaml
# SPDX-FileCopyrightText: Copyright The Zephyr Project Contributors
# SPDX-License-Identifier: Apache-2.0

description: BES2700iMP Development Kit LCDC panel

compatible: "bestechnic,bes2700imp-devkit-panel"

include: display-controller.yaml

properties:
  reg:
    required: true
    description: Board GPIO, mux, reset GPIO, reset mux, LCDC and DMA buffer regions.

  reg-names:
    required: true

  row-offset:
    type: int
    required: true
    description: Panel memory row corresponding to the first visible row.

  clock-pin:
    type: int
    required: true
    description: Clock bit within the display bus GPIO port.

  cs-pin:
    type: int
    required: true
    description: Active-low chip-select bit within the display bus GPIO port.

  data-pin-start:
    type: int
    required: true
    description: First of four consecutive data bits within the display bus GPIO port.

  reset-pin:
    type: int
    required: true
    description: Active-low reset bit within the reset GPIO port.
```

## dts/bindings/gpio/bestechnic,bes2700imp-gpio.yaml
```yaml
# SPDX-FileCopyrightText: Copyright The Zephyr Project Contributors
# SPDX-License-Identifier: Apache-2.0

description: BES2700iMP GPIO bank with PSC interrupt routing

compatible: "bestechnic,bes2700imp-gpio"

include: [base.yaml, gpio-controller.yaml]

properties:
  reg:
    required: true
    description: Address ranges of the GPIO bank and its PSC interrupt registers.

  reg-names:
    required: true

  interrupts:
    required: true

  interrupt-pin-mask:
    type: int
    required: true
    description: Bank pins routed to this PSC interrupt.

  "#gpio-cells":
    const: 2

gpio-cells:
  - pin
  - flags
```

## dts/bindings/input/zinitix,ztw623.yaml
```yaml
# SPDX-FileCopyrightText: Copyright The Zephyr Project Contributors
# SPDX-License-Identifier: Apache-2.0

description: Zinitix ZTW623 capacitive touchscreen controller

compatible: "zinitix,ztw623"

include: [i2c-device.yaml, touchscreen-common.yaml]

properties:
  irq-gpios:
    type: phandle-array
    required: true
    description: Active-low interrupt signal asserted while a sample is pending.

  reset-gpios:
    type: phandle-array
    required: true
    description: Active-low controller reset.
```

## soc/bestechnic/bes2700imp/Kconfig
```kconfig
# SPDX-FileCopyrightText: Copyright The Zephyr Project Contributors
# SPDX-License-Identifier: Apache-2.0

config SOC_BES2700IMP
	select ARM
	select CPU_CORTEX_M33
	select CPU_HAS_FPU
	select ARMV8_M_DSP
	select CPU_CORTEX_M_HAS_VTOR
	select CPU_CORTEX_M_HAS_SYSTICK
```

## soc/bestechnic/bes2700imp/Kconfig.defconfig
```kconfig
# SPDX-FileCopyrightText: Copyright The Zephyr Project Contributors
# SPDX-License-Identifier: Apache-2.0

if SOC_BES2700IMP

config NUM_IRQS
	default 78

config SYS_CLOCK_HW_CYCLES_PER_SEC
	default $(dt_node_int_prop_int,/cpus/cpu@0,clock-frequency) if CORTEX_M_SYSTICK

endif
```

## soc/bestechnic/bes2700imp/Kconfig.soc
```kconfig
# SPDX-FileCopyrightText: Copyright The Zephyr Project Contributors
# SPDX-License-Identifier: Apache-2.0

config SOC_BES2700IMP
	bool

config SOC
	default "bes2700imp" if SOC_BES2700IMP
```
